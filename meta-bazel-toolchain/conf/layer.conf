## meta-bazel-toolchain/conf/layer.conf
```bitbake
# We have a conf and classes directory, add to BBPATH
BBPATH .= ":${LAYERDIR}"

# We have recipes-* directories, add to BBFILES
BBFILES += "${LAYERDIR}/recipes-*/*/*.bb ${LAYERDIR}/recipes-*/*/*.bbappend"

BBFILE_COLLECTIONS += "bazel-toolchain"
BBFILE_PATTERN_bazel-toolchain = "^${LAYERDIR}/"
BBFILE_PRIORITY_bazel-toolchain = "1"

# This should only be incremented on significant changes that will
# cause compatibility issues with other layers
LAYERVERSION_bazel-toolchain = "1"

LAYERDEPENDS_bazel-toolchain = "core"

LAYERSERIES_COMPAT_bazel-toolchain = "scarthgap"
```
